## app/west.yml
```yaml
manifest:
  remotes:
    - name: sdk
      url-base: https://github.com/nrfconnect
  projects:
    - name: sdk-nrf
      remote: sdk
      revision: v2.5.2
      path: nrf
      import: true
      clone-depth: 1
  self:
    path: app
```
